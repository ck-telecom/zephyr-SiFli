## drivers/input/Kconfig
```kconfig
# Copyright (c) 2025, Qingsong Gou <gouqs@hotmail.com>
# SPDX-License-Identifier: Apache-2.0

if INPUT

module = INPUT
module-str = input
source "subsys/logging/Kconfig.template.log_config"

rsource "./Kconfig.*"

endif # INPUT
```

## drivers/watchdog/Kconfig
```kconfig
# SPDX-FileCopyrightText: 2025 SiFli Technologies(Nanjing) Co., Ltd
# SPDX-License-Identifier: Apache-2.0

if WATCHDOG

module = WDT
module-str = watchdog
source "subsys/logging/Kconfig.template.log_config"

rsource "./Kconfig.*"

endif # WATCHDOG
```

## drivers/watchdog/Kconfig.sf32lb
```kconfig
# SPDX-FileCopyrightText: 2025 SiFli Technologies(Nanjing) Co., Ltd
# SPDX-License-Identifier: Apache-2.0

config WDT_SF32LB
	bool
	default y
	depends on DT_HAS_SIFLI_SF32LB_WATCHDOG_ENABLED
```
